## components/lcd/Kconfig.projbuild
```kconfig
menu "LCD settings"
    config PCF8574_SDA_PIN
        int "SDA pin"
        default 32
        help
            Pin used for I2C data transference

    config PCF8574_SCL_PIN
        int "SCL pin"
        default 33
        help
            Pin used as I2C clock
    
    config PCF8574_DEV_ADDR
        hex "Device address"
        default 0x27
        help
            Device I2C address

    config PCF8574_SCL_SPEED_HZ
        int "SCL speed (Hz)"
        default 100000
        help
            Frequency of I2C clock

    config LCD_REFRESH_PERIOD
        int "LCD refresh period (ms)"
        default 50
        range 10 100
        help
            Time the LCD display awaits before updating its contents
endmenu
```

## main/Kconfig.projbuild
```kconfig
menu "PCF8574 settings"

    config PCF8574_SDA_PIN
        int "SDA pin"
        default 32
        help
            Pin used for I2C data transference

    config PCF8574_SCL_PIN
        int "SCL pin"
        default 33
        help
            Pin used as I2C clock
    
    config PCF8574_DEV_ADDR
        hex "Device address"
        default 0x27
        help
            Device I2C address

    config PCF8574_SCL_SPEED_HZ
        int "SCL speed (Hz)"
        default 100000
        help
            Frequency of I2C clock
endmenu
```
